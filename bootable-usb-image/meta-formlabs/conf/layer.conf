## bootable-usb-image/meta-formlabs/conf/layer.conf
```bitbake
# We have a conf and classes directory, add to BBPATH
BBPATH .= ":${LAYERDIR}"

# We have a packages directory, add to BBFILES
BBFILES += "${LAYERDIR}/recipes-*/*/*.bb \
            ${LAYERDIR}/recipes-*/*/*.bbappend"

BBFILE_COLLECTIONS += "formlabs"
BBFILE_PATTERN_formlabs := "^${LAYERDIR}/"
BBFILE_PRIORITY_formlabs = "6"
```
